OUTPUT_ARCH(arm)

SECTIONS {	
	. = 0;
	_start = . ;
	__romPos = 0;
	
	. = 0x03000000;
	.bss . : SUBALIGN(4) {
		build/src/code_080001f4.c.o(.bss*);
        build/src/code_08000718.c.o(.bss*);
	}
	
	. = 0x08000000;
	.cartrom . : AT(__romPos) SUBALIGN(4) {
		build/asm/rom_header.s.o(.text*);
		build/asm/boot.s.o(.text*);
		build/src/code_080001f4.c.o(.text*);
		build/src/code_08000718.c.o(.text*);
		build/bin/bindata_08000a00.bin.o(.rodata*); /* Seems to be ARM assembly */
        build/src/code_08001360.c.o(.text*);
        build/src/code_08001fe0.c.o(.text*);
        build/src/code_08002f68.c.o(.text*);
        build/src/code_08003b28.c.o(.text*);
        build/src/code_08004714.c.o(.text*);
		build/bin/bindata_0801e704.bin.o(.rodata*);
		*libgcc.a:_call_via_rX.o(.text*);
		build/bin/bindata_0804eb28.bin.o(.rodata*);
        build/data/data_0804f300.s.o(.text*);
        build/data/data_08054950.s.o(.text*);
        build/bin/bindata_08058f58.bin.o(.rodata*);
        build/bin/bindata_088f5aec.bin.o(.rodata*);
        build/bin/bindata_089000cc.bin.o(.rodata*);
        build/bin/bindata_0890a3c4.bin.o(.rodata*);
        build/bin/bindata_08932444.bin.o(.rodata*);
		build/bin/bindata_08935fac.bin.o(.rodata*);
        build/bin/bindata_089ccbc0.bin.o(.rodata*);
        build/bin/bindata_089d3984.bin.o(.rodata*);
        build/bin/bindata_08a9b078.bin.o(.rodata*);
        build/bin/bindata_08aa06f8.bin.o(.rodata*);
        
        build/audio/music/Lesson1.mid.o(.rodata*);
        build/audio/music/Lesson2.mid.o(.rodata*);
        build/audio/music/Lesson3.mid.o(.rodata*);
        build/audio/music/L1_pat01.mid.o(.rodata*);
        build/audio/music/L1_pat02.mid.o(.rodata*);
        build/audio/music/L1_pat03.mid.o(.rodata*);
        build/audio/music/L1_pat04.mid.o(.rodata*);
        build/audio/music/L1_pat05.mid.o(.rodata*);
        build/audio/music/L1_pat06.mid.o(.rodata*);
        build/audio/music/L1_pat07.mid.o(.rodata*);
        build/audio/music/L1_pat08.mid.o(.rodata*);
        build/audio/music/L1_pat09.mid.o(.rodata*);
        build/audio/music/L1_pat10.mid.o(.rodata*);
        build/audio/music/L1_pat11.mid.o(.rodata*);
        build/audio/music/L1_pat12.mid.o(.rodata*);
        build/audio/music/L1_pat13.mid.o(.rodata*);
        build/audio/music/L1_pat14.mid.o(.rodata*);
        build/audio/music/L1_pat15.mid.o(.rodata*);
        build/audio/music/L1_pat16.mid.o(.rodata*);
        build/audio/music/L2_pat00.mid.o(.rodata*);
        build/audio/music/L2_pat01.mid.o(.rodata*);
        build/audio/music/L2_pat02.mid.o(.rodata*);
        build/audio/music/L2_pat03.mid.o(.rodata*);
        build/audio/music/L2_pat04.mid.o(.rodata*);
        build/audio/music/L2_pat05.mid.o(.rodata*);
        build/audio/music/L2_pat06.mid.o(.rodata*);
        build/audio/music/L2_pat07.mid.o(.rodata*);
        build/audio/music/L2_pat08.mid.o(.rodata*);
        build/audio/music/L2_pat09.mid.o(.rodata*);
        build/audio/music/L2_pat10.mid.o(.rodata*);
        build/audio/music/L2_pat11.mid.o(.rodata*);
        build/audio/music/L2_pat12.mid.o(.rodata*);
        build/audio/music/L2_pat13.mid.o(.rodata*);
        build/audio/music/L2_pat14.mid.o(.rodata*);
        build/audio/music/L2_pat15.mid.o(.rodata*);
        build/audio/music/L2_pat16.mid.o(.rodata*);
        build/audio/music/L3_intro.mid.o(.rodata*);
        build/audio/music/L3_C32.mid.o(.rodata*);
        build/audio/music/L3_C32_no_swing.mid.o(.rodata*);
        build/audio/music/L3_C33.mid.o(.rodata*);
        build/audio/music/L3_C34.mid.o(.rodata*);
        build/audio/music/L3_C35.mid.o(.rodata*);
        build/audio/music/L3_C36.mid.o(.rodata*);
        build/audio/music/L3_C37.mid.o(.rodata*);
        build/audio/music/L3_C38.mid.o(.rodata*);
        build/audio/music/L3_C39.mid.o(.rodata*);
        build/audio/music/L3_C40.mid.o(.rodata*);
        build/audio/music/L3_C41_end.mid.o(.rodata*);
        build/audio/music/s_aimu_bgm.mid.o(.rodata*);
        build/audio/music/s_menu_bgm.mid.o(.rodata*);
        build/audio/music/s_shibafu1_bgm.mid.o(.rodata*);
        build/audio/music/s_shibafu2_bgm.mid.o(.rodata*);
        build/audio/music/s_tebyoushi_bgm.mid.o(.rodata*);
        build/audio/music/s_tebyoushi_dexy_bgm.mid.o(.rodata*);
        build/audio/music/s_tapdance_bgm.mid.o(.rodata*);
        build/audio/music/s_tapdance_ska_bgm.mid.o(.rodata*);
        build/audio/music/s_trex_bgm.mid.o(.rodata*);
        build/audio/music/s_trexnew_bgm1.mid.o(.rodata*);
        build/audio/music/s_trexnew_bgm2.mid.o(.rodata*);
        build/audio/music/s_poly_bgm.mid.o(.rodata*);
        build/audio/music/s_shuji_bgm1.mid.o(.rodata*);
        build/audio/music/s_shuji_bgm2.mid.o(.rodata*);
        build/audio/music/s_shuji_bgm3.mid.o(.rodata*);
        build/audio/music/s_shuji_bgm_end.mid.o(.rodata*);
        build/audio/music/s_puipui_bgm.mid.o(.rodata*);
        build/audio/music/s_puipui_intro_bgm.mid.o(.rodata*);
        build/audio/music/s_naniwa_bgm.mid.o(.rodata*);
        build/audio/music/s_emanikanto_bgm.mid.o(.rodata*);
        build/audio/music/s_emanikanto_bgm_loop.mid.o(.rodata*);
        build/audio/music/s_manza_bgm.mid.o(.rodata*);
        build/audio/music/s_hitmegeton1_bgm.mid.o(.rodata*);
        build/audio/music/s_hitmegeton2_bgm.mid.o(.rodata*);
        build/audio/music/s_bon_odori_bgm.mid.o(.rodata*);
        build/audio/music/s_bon_dance_bgm.mid.o(.rodata*);
        build/audio/music/s_4beat_bgm.mid.o(.rodata*);
        build/audio/music/s_toss_bgm.mid.o(.rodata*);
        build/audio/music/s_toss_bgm_end.mid.o(.rodata*);
        build/audio/music/s_toss_bgm_loop.mid.o(.rodata*);
        build/audio/music/s_title_bgm.mid.o(.rodata*);
        build/audio/music/s_koihoney_bgm.mid.o(.rodata*);
        build/audio/music/s_wish_bgm.mid.o(.rodata*);
        build/audio/music/L8_pat_intro.mid.o(.rodata*);
        build/audio/music/L8_pat01.mid.o(.rodata*);
        build/audio/music/L8_pat02.mid.o(.rodata*);
        build/audio/music/L8_pat03.mid.o(.rodata*);
        build/audio/music/L8_pat04.mid.o(.rodata*);
        build/audio/music/L8_pat05.mid.o(.rodata*);
        build/audio/music/L8_pat06.mid.o(.rodata*);
        build/audio/music/L8_pat07.mid.o(.rodata*);
        build/audio/music/L8_pat08.mid.o(.rodata*);
        build/audio/music/L8_pat09.mid.o(.rodata*);
        build/audio/music/L8_pat10.mid.o(.rodata*);
        build/audio/music/L8_pat11.mid.o(.rodata*);
        build/audio/music/L8_pat12.mid.o(.rodata*);
        build/audio/music/L8_pat_end.mid.o(.rodata*);
        build/audio/music/L8_pat_honki.mid.o(.rodata*);
        build/audio/music/s_menu_kettei0.mid.o(.rodata*);
        build/audio/music/s_menu_kettei1.mid.o(.rodata*);
        build/audio/music/s_menu_kettei2.mid.o(.rodata*);
        build/audio/music/s_menu_kettei3.mid.o(.rodata*);
        build/audio/music/s_menu_cancel1.mid.o(.rodata*);
        build/audio/music/s_menu_cancel2.mid.o(.rodata*);
        build/audio/music/s_menu_cancel3.mid.o(.rodata*);
        build/audio/music/s_menu_cursor1.mid.o(.rodata*);
        build/audio/music/s_menu_cursor2.mid.o(.rodata*);
        build/audio/music/s_menu_error.mid.o(.rodata*);
        build/audio/music/s_kansei.mid.o(.rodata*);
        build/audio/music/s_kansei_solo.mid.o(.rodata*);
        build/audio/music/s_warai.mid.o(.rodata*);
        build/audio/music/s_warai_little.mid.o(.rodata*);
        build/audio/music/s_warai_solo.mid.o(.rodata*);
        build/audio/music/s_hakushu_solo.mid.o(.rodata*);
        build/audio/music/s_BD1.mid.o(.rodata*);
        build/audio/music/s_BD2.mid.o(.rodata*);
        build/audio/music/s_BD3.mid.o(.rodata*);
        build/audio/music/s_BD4.mid.o(.rodata*);
        build/audio/music/s_BD5.mid.o(.rodata*);
        build/audio/music/s_BD6.mid.o(.rodata*);
        build/audio/music/s_BD7.mid.o(.rodata*);
        build/audio/music/s_BD8.mid.o(.rodata*);
        build/audio/music/s_BD9.mid.o(.rodata*);
        build/audio/music/s_SD1.mid.o(.rodata*);
        build/audio/music/s_SD2.mid.o(.rodata*);
        build/audio/music/s_SD3.mid.o(.rodata*);
        build/audio/music/s_SD4.mid.o(.rodata*);
        build/audio/music/s_SD5.mid.o(.rodata*);
        build/audio/music/s_SD6.mid.o(.rodata*);
        build/audio/music/s_SD7.mid.o(.rodata*);
        build/audio/music/s_SD8.mid.o(.rodata*);
        build/audio/music/s_SD9.mid.o(.rodata*);
        build/audio/music/s_tom_H.mid.o(.rodata*);
        build/audio/music/s_tom_M.mid.o(.rodata*);
        build/audio/music/s_tom_L.mid.o(.rodata*);
        build/audio/music/s_close_HH.mid.o(.rodata*);
        build/audio/music/s_open_HH.mid.o(.rodata*);
        build/audio/music/s_CC1.mid.o(.rodata*);
        build/audio/music/s_CC2.mid.o(.rodata*);
        build/audio/music/s_CC3.mid.o(.rodata*);
        build/audio/music/s_CC4.mid.o(.rodata*);
        build/audio/music/s_RC.mid.o(.rodata*);
        build/audio/music/s_HC.mid.o(.rodata*);
        build/audio/music/s_CC5.mid.o(.rodata*);
        build/audio/music/s_CC6.mid.o(.rodata*);
        build/audio/music/s_KN.mid.o(.rodata*);
        build/audio/music/s_HG.mid.o(.rodata*);
        build/audio/music/s_tran_jump.mid.o(.rodata*);
        build/audio/music/s_tran_henge.mid.o(.rodata*);
        build/audio/music/s_tran_seino.mid.o(.rodata*);
        build/audio/music/s_tran_hensin.mid.o(.rodata*);
        build/audio/music/s_tran_jump_se.mid.o(.rodata*);
        build/audio/music/s_toss_red_blue1.mid.o(.rodata*);
        build/audio/music/s_toss_red_blue2.mid.o(.rodata*);
        build/audio/music/s_toss_red_blue3.mid.o(.rodata*);
        build/audio/music/s_toss_red_yelw1.mid.o(.rodata*);
        build/audio/music/s_toss_red_yelw2.mid.o(.rodata*);
        build/audio/music/s_toss_red_yelw3.mid.o(.rodata*);
        build/audio/music/s_toss_red_red.mid.o(.rodata*);
        build/audio/music/s_toss_red_before.mid.o(.rodata*);
        build/audio/music/s_toss_red_break.mid.o(.rodata*);
        build/audio/music/s_toss_blue_red1.mid.o(.rodata*);
        build/audio/music/s_toss_blue_red2.mid.o(.rodata*);
        build/audio/music/s_toss_blue_red3.mid.o(.rodata*);
        build/audio/music/s_toss_blue_yelw1.mid.o(.rodata*);
        build/audio/music/s_toss_blue_yelw2.mid.o(.rodata*);
        build/audio/music/s_toss_blue_yelw3.mid.o(.rodata*);
        build/audio/music/s_toss_blue_blue.mid.o(.rodata*);
        build/audio/music/s_toss_blue_before.mid.o(.rodata*);
        build/audio/music/s_toss_blue_break.mid.o(.rodata*);
        build/audio/music/s_toss_yelw_red1.mid.o(.rodata*);
        build/audio/music/s_toss_yelw_red2.mid.o(.rodata*);
        build/audio/music/s_toss_yelw_red3.mid.o(.rodata*);
        build/audio/music/s_toss_yelw_blue1.mid.o(.rodata*);
        build/audio/music/s_toss_yelw_blue2.mid.o(.rodata*);
        build/audio/music/s_toss_yelw_blue3.mid.o(.rodata*);
        build/audio/music/s_toss_yelw_yelw.mid.o(.rodata*);
        build/audio/music/s_toss_yelw_before.mid.o(.rodata*);
        build/audio/music/s_toss_yelw_break.mid.o(.rodata*);
        build/audio/music/s_toss_ball_red.mid.o(.rodata*);
        build/audio/music/s_toss_ball_blue.mid.o(.rodata*);
        build/audio/music/s_toss_ball_yelw.mid.o(.rodata*);
        build/audio/music/s_toss_ball_haretu.mid.o(.rodata*);
        build/audio/music/s_shuji_ho.mid.o(.rodata*);
        build/audio/music/s_shuji_tame.mid.o(.rodata*);
        build/audio/music/s_iai_yarare.mid.o(.rodata*);
        build/audio/music/s_iai_miss.mid.o(.rodata*);
        build/audio/music/s_mario1.mid.o(.rodata*);
        build/audio/music/s_mario2.mid.o(.rodata*);
        build/audio/music/s_mario1_2.mid.o(.rodata*);
        build/audio/music/s_mario2_4.mid.o(.rodata*);
        build/audio/music/s_mario_melo1.mid.o(.rodata*);
        build/audio/music/s_mario_melo2.mid.o(.rodata*);
        build/audio/music/s_sword_orya.mid.o(.rodata*);
        build/audio/music/s_furi.mid.o(.rodata*);
        build/audio/music/s_sword_hi.mid.o(.rodata*);
        build/audio/music/s_sword_ho.mid.o(.rodata*);
        build/audio/music/s_iai_result.mid.o(.rodata*);
        build/audio/music/s_iai_bgm1.mid.o(.rodata*);
        build/audio/music/s_iai_bgm2.mid.o(.rodata*);
        build/audio/music/s_iai_bgm3.mid.o(.rodata*);
        build/audio/music/s_iai_frase1a.mid.o(.rodata*);
        build/audio/music/s_iai_frase2a.mid.o(.rodata*);
        build/audio/music/s_iai_frase3a.mid.o(.rodata*);
        build/audio/music/s_iai_frase1b.mid.o(.rodata*);
        build/audio/music/s_iai_frase2b.mid.o(.rodata*);
        build/audio/music/s_iai_frase3b.mid.o(.rodata*);
        build/audio/music/s_ninja_wind.mid.o(.rodata*);
        build/audio/music/s_ninja_chakuti.mid.o(.rodata*);
        build/audio/music/s_ninja_kamae.mid.o(.rodata*);
        build/audio/music/s_ninja_furu.mid.o(.rodata*);
        build/audio/music/s_ninja_kin.mid.o(.rodata*);
        build/audio/music/s_ninja_hit.mid.o(.rodata*);
        build/audio/music/s_ninja_yumi.mid.o(.rodata*);
        build/audio/music/s_ninja_kabe.mid.o(.rodata*);
        build/audio/music/s_ninja_bgm1.mid.o(.rodata*);
        build/audio/music/s_ninja_bgm2.mid.o(.rodata*);
        build/audio/music/s_rat_bgm1.mid.o(.rodata*);
        build/audio/music/s_rat_bgm2.mid.o(.rodata*);
        build/audio/music/s_rat_cat.mid.o(.rodata*);
        build/audio/music/s_rat_crush_R.mid.o(.rodata*);
        build/audio/music/s_rat_crush_L.mid.o(.rodata*);
        build/audio/music/s_rat_signal.mid.o(.rodata*);
        build/audio/music/s_rat_dash.mid.o(.rodata*);
        build/audio/music/s_rat_stop.mid.o(.rodata*);
        build/audio/music/s_tebyoushi_pati.mid.o(.rodata*);
        build/audio/music/s_bon_dondon1.mid.o(.rodata*);
        build/audio/music/s_bon_dondon1_1.mid.o(.rodata*);
        build/audio/music/s_bon_dondon1_2.mid.o(.rodata*);
        build/audio/music/s_bon_dondon2.mid.o(.rodata*);
        build/audio/music/s_hanabi_hyu.mid.o(.rodata*);
        build/audio/music/s_hanabi_don.mid.o(.rodata*);
        build/audio/music/s_hanabi_pon.mid.o(.rodata*);
        build/audio/music/s_hanabi_utiage.mid.o(.rodata*);
        build/audio/music/s_hanabi_utiage_v.mid.o(.rodata*);
        build/audio/music/s_hanabi_bgm.mid.o(.rodata*);
        build/audio/music/s_hanabi_1.mid.o(.rodata*);
        build/audio/music/s_hanabi_2.mid.o(.rodata*);
        build/audio/music/s_hanabi_3.mid.o(.rodata*);
        build/audio/music/s_hanabi_hai.mid.o(.rodata*);
        build/audio/music/s_hanabi_ah.mid.o(.rodata*);
        build/audio/music/s_hanabi_wish1.mid.o(.rodata*);
        build/audio/music/s_hanabi_wish2.mid.o(.rodata*);
        build/audio/music/s_hanabi_wish3.mid.o(.rodata*);
        build/audio/music/s_hanabi_wish4.mid.o(.rodata*);
        build/audio/music/s_intro_stick.mid.o(.rodata*);
        build/audio/music/s_intro_a.mid.o(.rodata*);
        build/audio/music/s_intro_one.mid.o(.rodata*);
        build/audio/music/s_intro_two.mid.o(.rodata*);
        build/audio/music/s_intro_three.mid.o(.rodata*);
        build/audio/music/s_intro_four.mid.o(.rodata*);
        build/audio/music/s_intro_uh.mid.o(.rodata*);
        build/audio/music/s_intro_comeon.mid.o(.rodata*);
        build/audio/music/s_intro_pat1.mid.o(.rodata*);
        build/audio/music/s_intro_pat2.mid.o(.rodata*);
        build/audio/music/s_intro_pat3.mid.o(.rodata*);
        build/audio/music/s_ghost_walk.mid.o(.rodata*);
        build/audio/music/s_ghost_just_hit.mid.o(.rodata*);
        build/audio/music/s_ghost_miss_hit.mid.o(.rodata*);
        build/audio/music/s_ghost_dash.mid.o(.rodata*);
        build/audio/music/s_ghost_warai.mid.o(.rodata*);
        build/audio/music/s_ghost_gosha.mid.o(.rodata*);
        build/audio/music/s_ghost_rain.mid.o(.rodata*);
        build/audio/music/s_space_ikeo_turn.mid.o(.rodata*);
        build/audio/music/s_space_ikeo_right.mid.o(.rodata*);
        build/audio/music/s_space_ikeo_lets.mid.o(.rodata*);
        build/audio/music/s_space_ikeo_sit.mid.o(.rodata*);
        build/audio/music/s_space_ikeo_down.mid.o(.rodata*);
        build/audio/music/s_space_ikeo_pa.mid.o(.rodata*);
        build/audio/music/s_space_ikeo_punch.mid.o(.rodata*);
        build/audio/music/s_space_kou_turn.mid.o(.rodata*);
        build/audio/music/s_space_kou_right.mid.o(.rodata*);
        build/audio/music/s_space_kou_lets.mid.o(.rodata*);
        build/audio/music/s_space_kou_sit.mid.o(.rodata*);
        build/audio/music/s_space_kou_down.mid.o(.rodata*);
        build/audio/music/s_space_kou_pa.mid.o(.rodata*);
        build/audio/music/s_space_kou_punch.mid.o(.rodata*);
        build/audio/music/s_space_miss.mid.o(.rodata*);
        build/audio/music/s_space_ikeo_turn_swing.mid.o(.rodata*);
        build/audio/music/s_space_kou_turn_swing.mid.o(.rodata*);
        build/audio/music/s_guntai1.mid.o(.rodata*);
        build/audio/music/s_guntai2.mid.o(.rodata*);
        build/audio/music/s_guntai_foot1.mid.o(.rodata*);
        build/audio/music/s_guntai_foot2.mid.o(.rodata*);
        build/audio/music/s_guntai_v_zentai1.mid.o(.rodata*);
        build/audio/music/s_guntai_v_zentai2.mid.o(.rodata*);
        build/audio/music/s_guntai_v_susume.mid.o(.rodata*);
        build/audio/music/s_guntai_v_tomare.mid.o(.rodata*);
        build/audio/music/s_guntai_v_migi_muke1.mid.o(.rodata*);
        build/audio/music/s_guntai_v_migi_muke2.mid.o(.rodata*);
        build/audio/music/s_guntai_v_hidari_muke1.mid.o(.rodata*);
        build/audio/music/s_guntai_v_hidari_muke2.mid.o(.rodata*);
        build/audio/music/s_guntai_v_migi.mid.o(.rodata*);
        build/audio/music/s_guntai_v_hidari.mid.o(.rodata*);
        build/audio/music/s_guntai_v_yoh.mid.o(.rodata*);
        build/audio/music/s_guntai_v_es.mid.o(.rodata*);
        build/audio/music/s_guntai_v_ka.mid.o(.rodata*);
        build/audio/music/s_guntai_ikari.mid.o(.rodata*);
        build/audio/music/s_block_gotin.mid.o(.rodata*);
        build/audio/music/s_block_hit.mid.o(.rodata*);
        build/audio/music/s_block_walk.mid.o(.rodata*);
        build/audio/music/s_kawasemi_bgm.mid.o(.rodata*);
        build/audio/music/s_kawasemi_frase.mid.o(.rodata*);
        build/audio/music/s_heat_v_jituhane.mid.o(.rodata*);
        build/audio/music/s_heat_v_watasine.mid.o(.rodata*);
        build/audio/music/s_heat_v_watasitara.mid.o(.rodata*);
        build/audio/music/s_heat_v_anataga.mid.o(.rodata*);
        build/audio/music/s_heat_v_anatatara.mid.o(.rodata*);
        build/audio/music/s_heat_v_kimiga.mid.o(.rodata*);
        build/audio/music/s_heat_v_doji.mid.o(.rodata*);
        build/audio/music/s_heat_v_sugoi.mid.o(.rodata*);
        build/audio/music/s_heat_v_koumietemo.mid.o(.rodata*);
        build/audio/music/s_heat_v_okubyo.mid.o(.rodata*);
        build/audio/music/s_heat_v_majime.mid.o(.rodata*);
        build/audio/music/s_heat_v_kouitta.mid.o(.rodata*);
        build/audio/music/s_heat_v_demo.mid.o(.rodata*);
        build/audio/music/s_heat_v_yappari.mid.o(.rodata*);
        build/audio/music/s_heat_v_dakedo.mid.o(.rodata*);
        build/audio/music/s_heat_v_suki.mid.o(.rodata*);
        build/audio/music/s_heat_v_kirai.mid.o(.rodata*);
        build/audio/music/s_heat_v_seki.mid.o(.rodata*);
        build/audio/music/s_heat_machine_bgm.mid.o(.rodata*);
        build/audio/music/s_metro_tin.mid.o(.rodata*);
        build/audio/music/s_metro_count1.mid.o(.rodata*);
        build/audio/music/s_metro_count2.mid.o(.rodata*);
        build/audio/music/s_metro_hato.mid.o(.rodata*);
        build/audio/music/s_metro_hit.mid.o(.rodata*);
        build/audio/music/s_batter_hit.mid.o(.rodata*);
        build/audio/music/s_batter_mit.mid.o(.rodata*);
        build/audio/music/s_keytoy_count1.mid.o(.rodata*);
        build/audio/music/s_keytoy_count2.mid.o(.rodata*);
        build/audio/music/s_mitubati.mid.o(.rodata*);
        build/audio/music/s_witch_candy.mid.o(.rodata*);
        build/audio/music/s_witch_furu.mid.o(.rodata*);
        build/audio/music/s_witch_cake.mid.o(.rodata*);
        build/audio/music/s_witch_donats.mid.o(.rodata*);
        build/audio/music/s_rabbit_jet.mid.o(.rodata*);
        build/audio/music/s_rabbit_break2.mid.o(.rodata*);
        build/audio/music/s_rabbit_c7_brass.mid.o(.rodata*);
        build/audio/music/s_rabbit_break.mid.o(.rodata*);
        build/audio/music/s_rabbit_HC.mid.o(.rodata*);
        build/audio/music/s_rabbit_bgm.mid.o(.rodata*);
        build/audio/music/s_rabbit_c7.mid.o(.rodata*);
        build/audio/music/s_rabbit_f7.mid.o(.rodata*);
        build/audio/music/s_rabbit_g7f7_1.mid.o(.rodata*);
        build/audio/music/s_rabbit_g7f7_2.mid.o(.rodata*);
        build/audio/music/s_rabbit_c7g7.mid.o(.rodata*);
        build/audio/music/s_rabbit_fill_1.mid.o(.rodata*);
        build/audio/music/s_rabbit_fill_2.mid.o(.rodata*);
        build/audio/music/s_rabbit_fill_3.mid.o(.rodata*);
        build/audio/music/s_rabbit_fill_4.mid.o(.rodata*);
        build/audio/music/s_rabbit_atama.mid.o(.rodata*);
        build/audio/music/s_rabbit_moon.mid.o(.rodata*);
        build/audio/music/s_tap_monky1.mid.o(.rodata*);
        build/audio/music/s_tap_monky2.mid.o(.rodata*);
        build/audio/music/s_tap_monky3_1.mid.o(.rodata*);
        build/audio/music/s_tap_monky3_2.mid.o(.rodata*);
        build/audio/music/s_tap_monky4.mid.o(.rodata*);
        build/audio/music/s_tap_kick_monky.mid.o(.rodata*);
        build/audio/music/s_tap_kick_lady.mid.o(.rodata*);
        build/audio/music/s_uma_walk1.mid.o(.rodata*);
        build/audio/music/s_uma_walk2.mid.o(.rodata*);
        build/audio/music/s_uma_walk3.mid.o(.rodata*);
        build/audio/music/s_uma_walk4.mid.o(.rodata*);
        build/audio/music/s_uma_trot1.mid.o(.rodata*);
        build/audio/music/s_uma_trot2.mid.o(.rodata*);
        build/audio/music/s_uma_canter1.mid.o(.rodata*);
        build/audio/music/s_uma_canter2.mid.o(.rodata*);
        build/audio/music/s_uma_canter3.mid.o(.rodata*);
        build/audio/music/s_uma_galop1.mid.o(.rodata*);
        build/audio/music/s_uma_galop2.mid.o(.rodata*);
        build/audio/music/s_uma_galop3.mid.o(.rodata*);
        build/audio/music/s_uma_galop4.mid.o(.rodata*);
        build/audio/music/s_uma_hihin.mid.o(.rodata*);
        build/audio/music/s_uma_bulu.mid.o(.rodata*);
        build/audio/music/s_uma_hi_muti.mid.o(.rodata*);
        build/audio/music/s_uma_ng.mid.o(.rodata*);
        build/audio/music/s_uma_walk1_t.mid.o(.rodata*);
        build/audio/music/s_uma_walk2_t.mid.o(.rodata*);
        build/audio/music/s_uma_walk3_t.mid.o(.rodata*);
        build/audio/music/s_uma_walk4_t.mid.o(.rodata*);
        build/audio/music/s_uma_trot1_t.mid.o(.rodata*);
        build/audio/music/s_uma_trot2_t.mid.o(.rodata*);
        build/audio/music/s_uma_canter1_t.mid.o(.rodata*);
        build/audio/music/s_uma_canter2_t.mid.o(.rodata*);
        build/audio/music/s_uma_canter3_t.mid.o(.rodata*);
        build/audio/music/s_uma_galop1_t.mid.o(.rodata*);
        build/audio/music/s_uma_galop2_t.mid.o(.rodata*);
        build/audio/music/s_uma_galop3_t.mid.o(.rodata*);
        build/audio/music/s_uma_galop4_t.mid.o(.rodata*);
        build/audio/music/s_uma_bgm1.mid.o(.rodata*);
        build/audio/music/s_uma_bgm2.mid.o(.rodata*);
        build/audio/music/s_uma_bgm3.mid.o(.rodata*);
        build/audio/music/s_uma_bgm4.mid.o(.rodata*);
        build/audio/music/s_karate_bgm.mid.o(.rodata*);
        build/audio/music/s_karate_fan.mid.o(.rodata*);
        build/audio/music/s_datumo_nuki.mid.o(.rodata*);
        build/audio/music/s_datumo_kegire.mid.o(.rodata*);
        build/audio/music/s_datumo_bgm.mid.o(.rodata*);
        build/audio/music/s_rap_bgm_renshu.mid.o(.rodata*);
        build/audio/music/s_rap_bgm.mid.o(.rodata*);
        build/audio/music/s_rap_jazz_bgm.mid.o(.rodata*);
        build/audio/music/s_rap_15ji_desuka.mid.o(.rodata*);
        build/audio/music/s_rap_oyatu_desuka.mid.o(.rodata*);
        build/audio/music/s_rap_honto_desuka.mid.o(.rodata*);
        build/audio/music/s_rap_wakari_desuka.mid.o(.rodata*);
        build/audio/music/s_rap_oisi_kamone.mid.o(.rodata*);
        build/audio/music/s_rap_herusi_kamone.mid.o(.rodata*);
        build/audio/music/s_rap_orenosei_kamone.mid.o(.rodata*);
        build/audio/music/s_rap_soremoso_kamone.mid.o(.rodata*);
        build/audio/music/s_rap_tanosi_kamone.mid.o(.rodata*);
        build/audio/music/s_rap_oyatuha_saiko.mid.o(.rodata*);
        build/audio/music/s_rap_kibunha_saiko.mid.o(.rodata*);
        build/audio/music/s_rap_orette_saiko.mid.o(.rodata*);
        build/audio/music/s_rap_kimitte_saiko.mid.o(.rodata*);
        build/audio/music/s_rap_oyatuga_naiyo.mid.o(.rodata*);
        build/audio/music/s_rap_oresira_naiyo.mid.o(.rodata*);
        build/audio/music/s_rap_un.mid.o(.rodata*);
        build/audio/music/s_rap_uun.mid.o(.rodata*);
        build/audio/music/s_rap_yeah.mid.o(.rodata*);
        build/audio/music/s_sindan_manzai.mid.o(.rodata*);
        build/audio/music/s_sindan_mail.mid.o(.rodata*);
        build/audio/music/s_esa_pengin1_1.mid.o(.rodata*);
        build/audio/music/s_esa_pengin1_2.mid.o(.rodata*);
        build/audio/music/s_esa_pengin1_3.mid.o(.rodata*);
        build/audio/music/s_esa_pengin2_1.mid.o(.rodata*);
        build/audio/music/s_esa_pengin2_2.mid.o(.rodata*);
        build/audio/music/s_esa_pengin2_3.mid.o(.rodata*);
        build/audio/music/s_esa_pengin3_1.mid.o(.rodata*);
        build/audio/music/s_esa_pengin3_2.mid.o(.rodata*);
        build/audio/music/s_esa_pengin3_3.mid.o(.rodata*);
        build/audio/music/s_esa_catch.mid.o(.rodata*);
        build/audio/music/s_quiz_bgm.mid.o(.rodata*);
        build/audio/music/s_quiz_fan_good.mid.o(.rodata*);
        build/audio/music/s_quiz_fan_bad.mid.o(.rodata*);
        build/audio/music/s_virus_fork.mid.o(.rodata*);
        build/audio/music/s_virus_dash.mid.o(.rodata*);
        build/audio/music/s_virus_miss.mid.o(.rodata*);
        build/audio/music/s_virus_hit.mid.o(.rodata*);
        build/audio/music/s_virus_osii.mid.o(.rodata*);
        build/audio/music/s_check_result_bgm.mid.o(.rodata*);
        build/audio/music/s_lesson_sel_bgm.mid.o(.rodata*);
        build/audio/music/s_toys_bgm.mid.o(.rodata*);
        build/audio/music/s_rap_machine_bgm.mid.o(.rodata*);
        build/audio/music/s_mini_game_bgm.mid.o(.rodata*);
        build/audio/music/s_remix_all_bgm.mid.o(.rodata*);
        build/audio/music/s_sindan_sea.mid.o(.rodata*);
        build/audio/music/s_drum_lesson_bgm.mid.o(.rodata*);
        build/audio/music/s_counseling_bgm.mid.o(.rodata*);
        build/audio/music/s_gameover_fan.mid.o(.rodata*);
        build/audio/music/s_studio_bgm.mid.o(.rodata*);
        build/audio/music/s_nyuka_fan.mid.o(.rodata*);
        build/audio/music/s_siryo_bgm.mid.o(.rodata*);
        build/audio/music/s_dr_sam_bgm.mid.o(.rodata*);
        build/audio/music/s_renshu_bgm1.mid.o(.rodata*);
        build/audio/music/s_renshu_bgm2.mid.o(.rodata*);
        build/audio/music/s_renshu_bgm3.mid.o(.rodata*);
        build/audio/music/s_kekka_bgm_good.mid.o(.rodata*);
        build/audio/music/s_kekka_bgm_common.mid.o(.rodata*);
        build/audio/music/s_kekka_bgm_bad.mid.o(.rodata*);
        build/audio/music/s_epilogue_fan1.mid.o(.rodata*);
        build/audio/music/s_epilogue_fan2.mid.o(.rodata*);
        build/audio/music/s_perfect_fan.mid.o(.rodata*);
        build/audio/music/s_poly_rakka.mid.o(.rodata*);
        build/audio/music/s_poly_shototu.mid.o(.rodata*);
        build/audio/music/s_block2_block.mid.o(.rodata*);
        build/audio/music/s_block2_fast.mid.o(.rodata*);
        build/audio/music/s_uki_water1.mid.o(.rodata*);
        build/audio/music/s_uki_water2.mid.o(.rodata*);
        build/audio/music/s_uki_water3.mid.o(.rodata*);
        build/audio/music/s_kuma_hit.mid.o(.rodata*);
        build/audio/music/s_kuma_miss.mid.o(.rodata*);
        build/audio/music/s_kuma_sakana.mid.o(.rodata*);
        build/audio/music/s_yuri_naki.mid.o(.rodata*);
        build/audio/music/s_yuri_yurasi.mid.o(.rodata*);
        build/audio/music/s_4beat_open.mid.o(.rodata*);
        build/audio/music/s_4beat_jiban.mid.o(.rodata*);
        build/audio/music/s_rythm_bat_miss.mid.o(.rodata*);
        build/audio/music/s_dontan_count.mid.o(.rodata*);
        build/audio/music/s_dontan_water.mid.o(.rodata*);
        build/audio/music/s_change_a.mid.o(.rodata*);
        build/audio/music/s_change_b.mid.o(.rodata*);
        build/audio/music/s_change_ball.mid.o(.rodata*);
        build/audio/music/s_change_hit_a.mid.o(.rodata*);
        build/audio/music/s_change_hit_b.mid.o(.rodata*);
        build/audio/music/s_change_goal.mid.o(.rodata*);
        build/audio/music/s_check_machine.mid.o(.rodata*);
        build/audio/music/s_check_trick1.mid.o(.rodata*);
        build/audio/music/s_check_trick2.mid.o(.rodata*);
        build/audio/music/s_check_trick3.mid.o(.rodata*);
        build/audio/music/s_menu_se1.mid.o(.rodata*);
        build/audio/music/s_menu_se2.mid.o(.rodata*);
        build/audio/music/s_menu_se3.mid.o(.rodata*);
        build/audio/music/s_menu_se5.mid.o(.rodata*);
        build/audio/music/s_menu_se6.mid.o(.rodata*);
        build/audio/music/s_menu_se7.mid.o(.rodata*);
        build/audio/music/s_menu_se8.mid.o(.rodata*);
        build/audio/music/s_menu_se9.mid.o(.rodata*);
        build/audio/music/s_menu_se10.mid.o(.rodata*);
        build/audio/music/s_menu_se11.mid.o(.rodata*);
        build/audio/music/s_menu_se12.mid.o(.rodata*);
        build/audio/music/s_menu_se13.mid.o(.rodata*);
        build/audio/music/s_menu_se14.mid.o(.rodata*);
        build/audio/music/s_menu_se15.mid.o(.rodata*);
        build/audio/music/s_menu_se16.mid.o(.rodata*);
        build/audio/music/s_menu_se17.mid.o(.rodata*);
        build/audio/music/s_menu_woodblock.mid.o(.rodata*);
        build/audio/music/s_menu_se19.mid.o(.rodata*);
        build/audio/music/s_menu_se20.mid.o(.rodata*);
        build/audio/music/s_menu_se22.mid.o(.rodata*);
        build/audio/music/s_menu_se23.mid.o(.rodata*);
        build/audio/music/s_menu_se24.mid.o(.rodata*);
        build/audio/music/s_menu_se25.mid.o(.rodata*);
        build/audio/music/s_jingle_rat.mid.o(.rodata*);
        build/audio/music/s_jingle_march.mid.o(.rodata*);
        build/audio/music/s_jingle_iai.mid.o(.rodata*);
        build/audio/music/s_jingle_ghost.mid.o(.rodata*);
        build/audio/music/s_jingle_poli.mid.o(.rodata*);
        build/audio/music/s_jingle_handclap.mid.o(.rodata*);
        build/audio/music/s_jingle_tap.mid.o(.rodata*);
        build/audio/music/s_jingle_baseball.mid.o(.rodata*);
        build/audio/music/s_jingle_toss.mid.o(.rodata*);
        build/audio/music/s_jingle_karate.mid.o(.rodata*);
        build/audio/music/s_jingle_witch.mid.o(.rodata*);
        build/audio/music/s_jingle_datumo.mid.o(.rodata*);
        build/audio/music/s_jingle_quiz.mid.o(.rodata*);
        build/audio/music/s_jingle_bon.mid.o(.rodata*);
        build/audio/music/s_jingle_rap.mid.o(.rodata*);
        build/audio/music/s_jingle_remix.mid.o(.rodata*);
        build/audio/music/s_fanfare_drum1.mid.o(.rodata*);
        build/audio/music/s_fanfare_drum2.mid.o(.rodata*);
        build/audio/music/s_fanfare_drum3.mid.o(.rodata*);
        build/audio/music/s_jingle_hi_level.mid.o(.rodata*);
        build/audio/music/s_ending_bgm.mid.o(.rodata*);
        build/audio/music/s_iai_bgm_studio.mid.o(.rodata*);
        build/audio/music/s_rabbit_bgm_studio.mid.o(.rodata*);
        build/audio/music/s_rat_bgm_studio.mid.o(.rodata*);
        build/audio/music/s_f_dummy.mid.o(.rodata*);
        build/audio/music/s_f_dummy_vol0.mid.o(.rodata*);
        build/audio/music/s_f_result_bad.mid.o(.rodata*);
        build/audio/music/s_f_result_normal.mid.o(.rodata*);
        build/audio/music/s_f_result_mes_step1.mid.o(.rodata*);
        build/audio/music/s_f_result_mes_step2.mid.o(.rodata*);
        build/audio/music/s_f_nyuuka.mid.o(.rodata*);
        build/audio/music/s_f_campaign_notice.mid.o(.rodata*);
        build/audio/music/s_f_open_game.mid.o(.rodata*);
        build/audio/music/s_f_clear_game.mid.o(.rodata*);
        build/audio/music/s_f_get_medal.mid.o(.rodata*);
        build/audio/music/s_f_point_roll.mid.o(.rodata*);
        build/audio/music/s_f_point_stop.mid.o(.rodata*);
        build/audio/music/s_f_appear_game.mid.o(.rodata*);
        build/audio/music/s_f_fail_perfect.mid.o(.rodata*);
        build/audio/music/s_f_result_mes_add.mid.o(.rodata*);
        build/audio/music/s_f_send_mes.mid.o(.rodata*);
        build/audio/music/s_f_pause_on.mid.o(.rodata*);
        build/audio/music/s_f_pause_cursor.mid.o(.rodata*);
        build/audio/music/s_f_pause_continue.mid.o(.rodata*);
        build/audio/music/s_f_pause_quit.mid.o(.rodata*);
        build/audio/music/s_f_scratch.mid.o(.rodata*);
        build/audio/music/s_f_env_train.mid.o(.rodata*);
        build/audio/music/s_f_env_cherry.mid.o(.rodata*);
        build/audio/music/s_f_env_haiku.mid.o(.rodata*);
        build/audio/music/s_f_env_class_room.mid.o(.rodata*);
        build/audio/music/s_f_env_paper.mid.o(.rodata*);
        build/audio/music/s_f_env_paper_rev.mid.o(.rodata*);
        build/audio/music/s_f_cafe_send_mes.mid.o(.rodata*);
        build/audio/music/s_f_drum_BD_1.mid.o(.rodata*);
        build/audio/music/s_f_drum_SD_1.mid.o(.rodata*);
        build/audio/music/s_f_drum_SD_Rim_Open.mid.o(.rodata*);
        build/audio/music/s_f_drum_Sym_Crash.mid.o(.rodata*);
        build/audio/music/s_f_test_drum_BD_A.mid.o(.rodata*);
        build/audio/music/s_f_test_drum_BD_B.mid.o(.rodata*);
        build/audio/music/s_f_test_drum_SD_A.mid.o(.rodata*);
        build/audio/music/s_f_test_drum_SD_B.mid.o(.rodata*);
        build/audio/music/s_f_toss_miss1.mid.o(.rodata*);
        build/audio/music/s_f_toss_miss2.mid.o(.rodata*);
        build/audio/music/s_f_toss_miss3.mid.o(.rodata*);
        build/audio/music/s_f_toss_ball.mid.o(.rodata*);
        build/audio/music/s_f_toss_swing.mid.o(.rodata*);
        build/audio/music/s_f_shuji_v_nuaa.mid.o(.rodata*);
        build/audio/music/s_f_shuji_v_unuu.mid.o(.rodata*);
        build/audio/music/s_f_shuji_v_ouch.mid.o(.rodata*);
        build/audio/music/s_f_shuji_swing1.mid.o(.rodata*);
        build/audio/music/s_f_shuji_swing2.mid.o(.rodata*);
        build/audio/music/s_f_shuji_start.mid.o(.rodata*);
        build/audio/music/s_f_shuji_v_ha1.mid.o(.rodata*);
        build/audio/music/s_f_shuji_v_ha2.mid.o(.rodata*);
        build/audio/music/s_f_shuji_v_ha3.mid.o(.rodata*);
        build/audio/music/s_f_shuji_v_funuue.mid.o(.rodata*);
        build/audio/music/s_f_shuji_v_nuahaha.mid.o(.rodata*);
        build/audio/music/s_f_rat_goal.mid.o(.rodata*);
        build/audio/music/s_f_rat_error.mid.o(.rodata*);
        build/audio/music/s_f_rat_slip.mid.o(.rodata*);
        build/audio/music/s_f_hanabi_v_tamaya.mid.o(.rodata*);
        build/audio/music/s_f_hanabi_v_nuei.mid.o(.rodata*);
        build/audio/music/s_f_hanabi_kansei.mid.o(.rodata*);
        build/audio/music/s_f_iai_cut.mid.o(.rodata*);
        build/audio/music/s_f_iai_cut2.mid.o(.rodata*);
        build/audio/music/s_f_iai_title.mid.o(.rodata*);
        build/audio/music/s_f_virus_in.mid.o(.rodata*);
        build/audio/music/s_f_virus_uhihi.mid.o(.rodata*);
        build/audio/music/s_f_virus_hit.mid.o(.rodata*);
        build/audio/music/s_f_virus_osii.mid.o(.rodata*);
        build/audio/music/s_f_virus_face_fadeout.mid.o(.rodata*);
        build/audio/music/s_f_virus_note_land.mid.o(.rodata*);
        build/audio/music/s_f_hair_kegire.mid.o(.rodata*);
        build/audio/music/s_f_hair_next.mid.o(.rodata*);
        build/audio/music/s_f_hair_nuki_long.mid.o(.rodata*);
        build/audio/music/s_f_hair_tuneru.mid.o(.rodata*);
        build/audio/music/s_f_hair_appear_long.mid.o(.rodata*);
        build/audio/music/s_f_poly_blast.mid.o(.rodata*);
        build/audio/music/s_f_poly_withdraw.mid.o(.rodata*);
        build/audio/music/s_f_poly_close.mid.o(.rodata*);
        build/audio/music/s_f_poly_appear_upside.mid.o(.rodata*);
        build/audio/music/s_f_poly_appear_downside.mid.o(.rodata*);
        build/audio/music/s_f_poly_open_upside.mid.o(.rodata*);
        build/audio/music/s_f_poly_open_downside.mid.o(.rodata*);
        build/audio/music/s_f_boxing_punch.mid.o(.rodata*);
        build/audio/music/s_f_boxing_just_hati.mid.o(.rodata*);
        build/audio/music/s_f_boxing_just_hati_nc.mid.o(.rodata*);
        build/audio/music/s_f_boxing_just_light.mid.o(.rodata*);
        build/audio/music/s_f_boxing_just_light_nc.mid.o(.rodata*);
        build/audio/music/s_f_boxing_just_ball.mid.o(.rodata*);
        build/audio/music/s_f_boxing_just_ball_nc.mid.o(.rodata*);
        build/audio/music/s_f_boxing_just_rock.mid.o(.rodata*);
        build/audio/music/s_f_boxing_just_rock_nc.mid.o(.rodata*);
        build/audio/music/s_f_boxing_just_bomb.mid.o(.rodata*);
        build/audio/music/s_f_boxing_normal.mid.o(.rodata*);
        build/audio/music/s_f_boxing_land.mid.o(.rodata*);
        build/audio/music/s_f_boxing_fly_nml.mid.o(.rodata*);
        build/audio/music/s_f_boxing_v_nua.mid.o(.rodata*);
        build/audio/music/s_f_boxing_hard.mid.o(.rodata*);
        build/audio/music/s_f_boxing_score_reset.mid.o(.rodata*);
        build/audio/music/s_f_boxing_score_up.mid.o(.rodata*);
        build/audio/music/s_f_boxing_score_down.mid.o(.rodata*);
        build/audio/music/s_f_boxing_kansei.mid.o(.rodata*);
        build/audio/music/s_f_boxing_v_fresh.mid.o(.rodata*);
        build/audio/music/s_f_boxing_title_hit.mid.o(.rodata*);
        build/audio/music/s_f_boxing_honki.mid.o(.rodata*);
        build/audio/music/s_f_boxing_fly_ext.mid.o(.rodata*);
        build/audio/music/s_f_quiz_hit_ply.mid.o(.rodata*);
        build/audio/music/s_f_quiz_hit_com.mid.o(.rodata*);
        build/audio/music/s_f_quiz_blast_ply.mid.o(.rodata*);
        build/audio/music/s_f_quiz_blast_com.mid.o(.rodata*);
        build/audio/music/s_f_quiz_blast_plate.mid.o(.rodata*);
        build/audio/music/s_f_quiz_miss.mid.o(.rodata*);
        build/audio/music/s_f_quiz_stop.mid.o(.rodata*);
        build/audio/music/s_f_quiz_answer.mid.o(.rodata*);
        build/audio/music/s_f_quiz_ok.mid.o(.rodata*);
        build/audio/music/s_f_ninja_kabe.mid.o(.rodata*);
        build/audio/music/s_f_ninja_demo.mid.o(.rodata*);
        build/audio/music/s_f_ninja_v_nanu.mid.o(.rodata*);
        build/audio/music/s_f_rapW_v_YoOyatuDesuka.mid.o(.rodata*);
        build/audio/music/s_f_rapW_v_Yo10JiDesuka.mid.o(.rodata*);
        build/audio/music/s_f_rapW_v_Naishodesuka.mid.o(.rodata*);
        build/audio/music/s_f_rapW_v_KarenoOyatudane.mid.o(.rodata*);
        build/audio/music/s_f_rapW_v_TabeteIikamone.mid.o(.rodata*);
        build/audio/music/s_f_rapW_v_AketeIikamone.mid.o(.rodata*);
        build/audio/music/s_f_rapW_v_OyatuwaSaiko.mid.o(.rodata*);
        build/audio/music/s_f_rapW_v_KibunnwaSaiko.mid.o(.rodata*);
        build/audio/music/s_f_rapW_v_AmakuteSaiko.mid.o(.rodata*);
        build/audio/music/s_f_rapW_v_BetubaraSaiko.mid.o(.rodata*);
        build/audio/music/s_f_rapW_v_KareniwaNaisho.mid.o(.rodata*);
        build/audio/music/s_f_rapW_v_DarenimoNaisho.mid.o(.rodata*);
        build/audio/music/s_f_rapW_v_Yeah.mid.o(.rodata*);
        build/audio/music/s_f_rapW_v_Un.mid.o(.rodata*);
        build/audio/music/s_f_rapW_v_Uun.mid.o(.rodata*);
        build/audio/music/s_f_rapW_v_CheckIt.mid.o(.rodata*);
        build/audio/music/s_f_rapW_v_OyatuwaSaiko_d.mid.o(.rodata*);
        build/audio/music/s_f_rapW_v_KibunnwaSaiko_d.mid.o(.rodata*);
        build/audio/music/s_f_rapW_v_AmakuteSaiko_d.mid.o(.rodata*);
        build/audio/music/s_f_rapW_v_BetubaraSaiko_d.mid.o(.rodata*);
        build/audio/music/s_f_batter_ball_land.mid.o(.rodata*);
        build/audio/music/s_f_batter_ball_high.mid.o(.rodata*);
        build/audio/music/s_f_handclap_pi_G4.mid.o(.rodata*);
        build/audio/music/s_f_handclap_pi_E5.mid.o(.rodata*);
        build/audio/music/s_f_handclap_ready.mid.o(.rodata*);
        build/audio/music/s_f_aim_just_hit.mid.o(.rodata*);
        build/audio/music/s_f_aim_just_hit_voice.mid.o(.rodata*);
        build/audio/music/s_f_space_hit.mid.o(.rodata*);
        build/audio/music/s_f_space_dancer.mid.o(.rodata*);
        build/audio/music/s_f_space_dancer_swing.mid.o(.rodata*);
        build/audio/music/s_f_space_dancer_sit.mid.o(.rodata*);
        build/audio/music/s_f_space_dancer_pa.mid.o(.rodata*);
        build/audio/music/s_f_esa_jump.mid.o(.rodata*);
        build/audio/music/s_f_esa_splash_penguin.mid.o(.rodata*);
        build/audio/music/s_f_esa_splash_ball.mid.o(.rodata*);
        build/audio/music/s_f_rabbit_ready.mid.o(.rodata*);
        build/audio/music/s_f_rabbit_miss.mid.o(.rodata*);
        build/audio/music/s_f_even_splash.mid.o(.rodata*);
        build/audio/music/s_f_even_road.mid.o(.rodata*);
        build/audio/music/s_f_drumdr_miss.mid.o(.rodata*);
        build/audio/music/s_f_drumdr_ok.mid.o(.rodata*);
        build/audio/music/s_f_machine_click.mid.o(.rodata*);
        build/audio/music/s_f_tap_miss1.mid.o(.rodata*);
        build/audio/music/s_f_tap_miss2.mid.o(.rodata*);
        build/audio/music/s_f_tap_jump_ready.mid.o(.rodata*);
        build/audio/music/s_f_tap_tap.mid.o(.rodata*);
        build/audio/music/s_f_tap_pig1.mid.o(.rodata*);
        build/audio/music/s_f_tap_pig2.mid.o(.rodata*);
        build/audio/music/s_f_conveyer_hit.mid.o(.rodata*);
        build/audio/music/s_f_lesson_s.mid.o(.rodata*);
        build/audio/music/s_f_lesson_a.mid.o(.rodata*);
        build/audio/music/s_f_lesson_b.mid.o(.rodata*);
        build/audio/music/s_f_lesson_c.mid.o(.rodata*);
        build/audio/music/s_f_base_1note.mid.o(.rodata*);
        build/audio/music/s_f_drumtech_miss.mid.o(.rodata*);
        build/audio/music/s_f_drumtech_fall.mid.o(.rodata*);
        build/audio/music/s_f_drumtech_damage.mid.o(.rodata*);
        build/audio/music/s_f_neko1.mid.o(.rodata*);
        build/audio/music/s_f_neko2.mid.o(.rodata*);
        build/audio/music/s_f_neko3.mid.o(.rodata*);
        build/audio/music/s_f_neko4.mid.o(.rodata*);
        build/audio/music/s_f_neko5.mid.o(.rodata*);
        build/audio/music/s_f_neko6.mid.o(.rodata*);
        build/audio/music/s_f_marcher2_v_zentai.mid.o(.rodata*);
        build/audio/music/s_f_marcher2_v_susume.mid.o(.rodata*);
        build/audio/music/s_f_marcher2_v_tomare.mid.o(.rodata*);
        build/audio/music/s_f_marcher2_v_migimukeL.mid.o(.rodata*);
        build/audio/music/s_f_marcher2_v_migimukeS.mid.o(.rodata*);
        build/audio/music/s_f_marcher2_v_migi.mid.o(.rodata*);
        build/audio/music/s_f_marcher2_v_hidarimukeL.mid.o(.rodata*);
        build/audio/music/s_f_marcher2_v_hidarimukeS.mid.o(.rodata*);
        build/audio/music/s_f_marcher2_v_hidari.mid.o(.rodata*);
        
        build/bin/bindata_08bd0cac.bin.o(.rodata*);
        build/bin/bindata_08cc4bcc.bin.o(.rodata*);
	}

	_end = . ;
	 /DISCARD/ : {*(*);}
}